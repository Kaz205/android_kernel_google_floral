## drivers/input/touchscreen/fts_touch/Kconfig
```kconfig
#
# STMicroelectronics TOUCH driver configuration
#

config TOUCHSCREEN_FTS
	bool "STMicroelectronics multitouch touchscreen - FingerTipS (FTM5)"
	depends on SPI
	help
	  Say Y here to enable STMicroelectronics (FTM5) touchscreen support.
	  If unsure, say N.
```
